## application/Config.in
```kconfig
menu "Select the board"
    source "$BR2_EXTERNAL_APPLICATION_PATH/board/rpi5/Config.in"
endmenu

menu "Target packages"
    source "$BR2_EXTERNAL_APPLICATION_PATH/package/qt-menu/Config.in"
endmenu
```

## application/board/rpi5/Config.in
```kconfig
config BR2_TARGET_BOARD_RPI_5
    bool "Customize Raspberry Pi 5"
    help
      Use this option to build a custom Raspberry Pi 5 image.
```

## application/package/qt-menu/Config.in
```kconfig
config BR2_PACKAGE_QT_MENU
    bool "qt-menu"
    default y
    depends on BR2_PACKAGE_QT6BASE && BR2_PACKAGE_QT6DECLARATIVE
    help
      Menu and Settings GUI
```
